## examples/ssd1315_i2c/sdkconfig.defaults
```kconfig
CONFIG_FREERTOS_HZ=250

CONFIG_LIBC_NEWLIB=y

CONFIG_MONITOR_BAUD=115200

# CONFIG_BOOTLOADER_COMPILER_OPTIMIZATION_SIZE=y
# CONFIG_BOOTLOADER_COMPILER_OPTIMIZATION_DEBUG is not set
CONFIG_BOOTLOADER_COMPILER_OPTIMIZATION_PERF=y
```
